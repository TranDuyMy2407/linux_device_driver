/dts-v1/;

/
{
	cpus
	{
		#address-cells =  <1>;
		#size-cells = <0>;
		cpu@0
		{
			compatible = "arm-cortext-a9";
			reg = <0>;
		};
		
		cpu@1
		{
			compatible = "arm-cortext-a9";
			reg =  <1>;
		};
	};
};
